## package/python-nomadnet/Config.in
```kconfig
config BR2_PACKAGE_PYTHON_NOMADNET
	bool "python-nomadnet"
	help
	
	  Nomad Network - Communicate Freely
```

## package/python-pdoc3/Config.in
```kconfig
config BR2_PACKAGE_PYTHON_PDOC3
	bool "python-pdoc3"
	help
	
	  https://pypi.org/project/pdoc3/
```

## package/python-print-color/Config.in
```kconfig
config BR2_PACKAGE_PYTHON_PRINT_COLOR
	bool "python-printcolor"
	help
	
	  https://pypi.org/project/print-color
```

## package/python-pubsub/Config.in
```kconfig
config BR2_PACKAGE_PYTHON_PUBSUB
	bool "python-pubsub"
	help
    Provides a publish-subscribe API to facilitate event-based 
    or message-based architecture in a single-process application.
    

	  https://github.com/schollii/pypubsub
```

## package/python-pylint/Config.in
```kconfig
config BR2_PACKAGE_PYTHON_PYLINT
	bool "python-pylint"
	help
	
	  https://pypi.org/project/pylint/
```

## package/python-pytap2/Config.in
```kconfig
config BR2_PACKAGE_PYTHON_PYTAP2
	bool "python-pytap2"
	help
	
	  https://pypi.org/project/pytap2/
```

## package/python-pytestcov/Config.in
```kconfig
config BR2_PACKAGE_PYTHON_PYTESTCOV
	bool "python-pytestcov"
	help
	
	  https://pypi.org/project/pytest-cov/
```

## package/python-rns/Config.in
```kconfig
config BR2_PACKAGE_PYTHON_RNS
	bool "python-rns"
	help
	
	  Reticulum Network Stack β 
```

## package/python-tabulate/Config.in
```kconfig
config BR2_PACKAGE_PYTHON_TABULATE
	bool "python-tabulate"
	help
	
	  https://pypi.org/project/tabulate/
```

## package/python-taky/Config.in
```kconfig
config BR2_PACKAGE_PYTHON_TAKY
	bool "python-taky"
	select BR2_PACKAGE_HOST_PYTHON3
	select BR2_PACKAGE_PYTHON3
	select BR2_PACKAGE_PYTHON_LXML
	select BR2_PACKAGE_PYTHON_DATEUTIL
	select BR2_PACKAGE_PYTHON_FLASK
	select BR2_PACKAGE_PYTHON_PYOPENSSL
	select BR2_PACKAGE_PYTHON_GUNICORN
	select BR2_PACKAGE_PYTHON_REDIS
	help
	  A simple python TAK server
```

## package/python-timeago/Config.in
```kconfig
config BR2_PACKAGE_PYTHON_TIMEAGO
	bool "python-timeago"
	help
	
	  https://pypi.org/project/timeago/
```

## package/python-twine/Config.in
```kconfig
config BR2_PACKAGE_PYTHON_TWINE
	bool "python-twine"
	help
	
	  https://pypi.org/project/twine/
```

## package/qtencodeui/Config.in
```kconfig
config BR2_PACKAGE_QTENCODEUI
	bool "qtencodeui"
	depends on BR2_PACKAGE_QT5
	help
	  User interface for Hyperpixel display
```

## package/rpiboot/Config.in
```kconfig
config BR2_PACKAGE_RPIBOOT
        bool "rpiboot"
		select BR2_PACKAGE_LIBUSB
        help 
              rpiboot tool
```

## package/rtptun/Config.in
```kconfig
config BR2_PACKAGE_RTPTUN
        bool "rtptun"
		select BR2_PACKAGE_LIBEV 
        help 
              rtptun
              https://github.com/me-asri/rtptun
```

## package/samplicator/Config.in
```kconfig
config BR2_PACKAGE_SAMPLICATOR
        bool "samplicator" 
        help 
              UDP Samplicator 
              https://github.com/resiliencetheatre/samplicator
```

## package/tacmsgrouter/Config.in
```kconfig
config BR2_PACKAGE_TACMSGROUTER
        bool "tacmsgrouter"
        select BR2_PACKAGE_LIBCURL
        help 
              Simple fifo input output relay binary.
```

## package/udp2raw/Config.in
```kconfig
config BR2_PACKAGE_UDP2RAW
        bool "udp2raw"
        help 
              Tunnel for UDP traffic
```

## package/udpproxy/Config.in
```kconfig
config BR2_PACKAGE_UDPPROXY
        bool "udpproxy"
        help 
              udpproxy component
```

## package/udpspeeder/Config.in
```kconfig
config BR2_PACKAGE_UDPSPEEDER
        bool "udpspeeder"
        help 
              A Tunnel which Improves your Network Quality on a 
              High-latency Lossy Link by using Forward Error Correction,
              possible for All Traffics(TCP/UDP/ICMP).
              https://github.com/wangyu-/UDPspeeder      
		
```

## package/udptunnel/Config.in
```kconfig
config BR2_PACKAGE_UDPTUNNEL
        bool "udptunnel"
        help 
              otp variant of udptunnel
```
