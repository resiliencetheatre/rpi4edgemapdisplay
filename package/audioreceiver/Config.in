## package/audioreceiver/Config.in
```kconfig
config BR2_PACKAGE_AUDIORECEIVER
        bool "audioreceiver"
        select BR2_PACKAGE_GSTREAMER1
        select BR2_PACKAGE_GST1_PLUGINS_BASE
        help 
              gst audioreceiver
```

## package/audiostreamer/Config.in
```kconfig
config BR2_PACKAGE_AUDIOSTREAMER
        bool "audiostreamer"
        select BR2_PACKAGE_GSTREAMER1
        select BR2_PACKAGE_GST1_PLUGINS_BASE
        help 
              gst audiostreamer
```

## package/cotsim/Config.in
```kconfig
config BR2_PACKAGE_COTSIM
        bool "cotsim"
	select BR2_PACKAGE_LIBCURL
        help 
              CoT simulator
```

## package/coturn/Config.in
```kconfig
config BR2_PACKAGE_COTURN
        bool "coturn"
        help 
              coturn is a free open source implementation of TURN 
              and STUN Server. The TURN Server is a VoIP media 
              traffic NAT traversal server and gateway.
```

## package/curlcot/Config.in
```kconfig
config BR2_PACKAGE_CURLCOT
        bool "curlcot"
	select BR2_PACKAGE_LIBCURL
        help 
           Simple CoT reader with libcurl.
```

## package/dpinger/Config.in
```kconfig
config BR2_PACKAGE_DPINGER
        bool "dpinger"
        help 
              Pinger engine for monitoring latency and loss 
```

## package/gpsreader/Config.in
```kconfig
config BR2_PACKAGE_GPSREADER
        bool "gpsreader"
        help 
              gpsd gpsreader
```

## package/gsocket/Config.in
```kconfig
config BR2_PACKAGE_GSOCKET
        bool "gsocket" 
        help 
              gsocket
              Connect like there is no firewall. Securely. 
              https://github.com/hackerschoice/gsocket
```

## package/highrate/Config.in
```kconfig
config BR2_PACKAGE_HIGHRATE
        bool "highrate"
        select BR2_PACKAGE_LIBCURL
        help 
              simple text file reader and writer for CoT simulation
```

## package/libblinkstick/Config.in
```kconfig
config BR2_PACKAGE_LIBBLINKSTICK
	bool "libblinkstick"
	select BR2_PACKAGE_LIBHID
	select BR2_PACKAGE_LIBUSB
	select BR2_PACKAGE_HIDAPI
	help
	  A blinkstick library written in C
```

## package/libfido2/Config.in
```kconfig
config BR2_PACKAGE_LIBFIDO2
	bool "libfido2"
	depends on BR2_PACKAGE_HAS_UDEV
	# depends on BR2_PACKAGE_PCSC_LITE
	depends on BR2_PACKAGE_SYSTEMD
	help
	 libfido2 library
```

## package/libnitrokey/Config.in
```kconfig
config BR2_PACKAGE_LIBNITROKEY
	bool "libnitrokey"
	select BR2_PACKAGE_LIBHID
	select BR2_PACKAGE_LIBARGON2
	select BR2_PACKAGE_LIBUSB
	select BR2_PACKAGE_CCID
	select BR2_PACKAGE_HIDAPI
	help
	  Userspace library for Nitrokey hardware
```

## package/modmodem/Config.in
```kconfig
config BR2_PACKAGE_MODMODEM
        bool "modmodem"

        help 
              OFDM modem
```

## package/netmon/Config.in
```kconfig
config BR2_PACKAGE_NETMON
        bool "netmon"
        help 
              netmon binary
```

## package/nkmacsec/Config.in
```kconfig
config BR2_PACKAGE_NKMACSEC
        bool "nkmacsec"
	select BR2_PACKAGE_LIBNITROKEY
        help 
              out-of-band keying for macsec with Nitrokey
```

## package/pttcomm/Config.in
```kconfig
config BR2_PACKAGE_PTTCOMM
        bool "pttcomm"
        select BR2_PACKAGE_GSTREAMER1
        select BR2_PACKAGE_GST1_PLUGINS_BASE
        help 
              pttcomm
```

## package/python-argparse/Config.in
```kconfig
config BR2_PACKAGE_PYTHON_ARGPARSE
	bool "python-argparse"
	help
	  Python command-line parsing library.

	  https://github.com/ThomasWaldmann/argparse/
```

## package/python-autopep8/Config.in
```kconfig
config BR2_PACKAGE_PYTHON_AUTOPEP8
	bool "python-autopep8"
	help
	
	  https://pypi.org/project/autopep8/
```

## package/python-cxfreeze/Config.in
```kconfig
config BR2_PACKAGE_PYTHON_CXFREEZE
	bool "python-cxfreeze"
	help
	
	  Create standalone executables from Python scripts
```

## package/python-dateutils/Config.in
```kconfig
config BR2_PACKAGE_PYTHON_DATEUTILS
	bool "python-dateutils"
	select BR2_PACKAGE_PYTHON_ARGPARSE # runtime
	select BR2_PACKAGE_PYTHON_DATEUTIL # runtime
	select BR2_PACKAGE_PYTHON_PYTZ # runtime
	help
	  Various utilities for working with date and datetime
	  objects.

	  https://github.com/jmcantrell/python-dateutils
```

## package/python-dotmap/Config.in
```kconfig
config BR2_PACKAGE_PYTHON_DOTMAP
	bool "python-dotmap"
	help
	
	  https://pypi.org/project/dotmap/
```

## package/python-lxmf/Config.in
```kconfig
config BR2_PACKAGE_PYTHON_LXMF
	bool "python-lxmf"
	help
	
	  Lightweight Extensible Message Format
```

## package/python-meshtastic/Config.in
```kconfig
config BR2_PACKAGE_PYTHON_MESHTASTIC
	bool "python-meshtastic"
	help
	A Python client for use with Meshtastic devices. This small 
	library (and example application) provides an easy API for 
	sending and receiving messages over mesh radios. It also 
	provides access to any of the operations/data available 
	in the device user interface or the Android application. 
	Events are delivered using a publish-subscribe model, and 
	you can subscribe to only the message types you are 
	interested in.

	  https://pypi.org/project/meshtastic/
```
